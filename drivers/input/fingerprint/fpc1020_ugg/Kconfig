## drivers/input/fingerprint/fpc1020_ugg/Kconfig
```kconfig
config FINGERPRINT_FPC1020_UGG
    tristate "fpc1020 fingerprint "
    help
        say y enable fpc
```

## drivers/input/fingerprint/gf3208_ugg/Kconfig
```kconfig
config FINGERPRINT_GF3208_UGG
	tristate "gf3208 fingerprint"
	help
	    say y enable  gf3208 goodix
```
